&uart0 {
	compatible = "nordic,nrf-uarte";
};

&spi1 {
	compatible = "nordic,nrf-spim";
	status = "okay";
	sck-pin = < 22 >;
	mosi-pin = < 29 >;
	miso-pin = < 24 >;
	cs-gpios = <&gpio1 10 GPIO_ACTIVE_LOW>, <&gpio1 13 GPIO_ACTIVE_LOW>, <&gpio1 15 GPIO_ACTIVE_LOW>, <&gpio0 2 GPIO_ACTIVE_LOW>, <&gpio0 13 GPIO_ACTIVE_LOW>, <&gpio0 15 GPIO_ACTIVE_LOW>, <&gpio0 17 GPIO_ACTIVE_LOW>;
};
