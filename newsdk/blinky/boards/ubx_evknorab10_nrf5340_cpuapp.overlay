/{
		leds {
		compatible = "gpio-leds";
		led0: led_0 {
			gpios = <&gpio0 30 GPIO_ACTIVE_LOW>;
			label = "Red LED 0";
		};
	};
};
// &spi2 {
// 	compatible = "nordic,nrf-spim";
// 	status = "okay";
// 	sck-pin = <7>;  // original 8
// 	miso-pin = <8>;  // original 9
// 	mosi-pin = <9>;  // original 10
// };

